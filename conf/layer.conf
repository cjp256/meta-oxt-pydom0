## conf/layer.conf
```bitbake
# We have a conf and classes directory, append to BBPATH
BBPATH .= ":${LAYERDIR}"

# We have a recipes directory, add to BBFILES
BBFILES += "${LAYERDIR}/recipes*/*/*.bb ${LAYERDIR}/recipes*/*/*.bbappend"

BBFILE_COLLECTIONS += "oxt-pydom0-layer"
BBFILE_PATTERN_oxt-pydom0-layer := "^${LAYERDIR}/"
BBFILE_PRIORITY_oxt-pydom0-layer = "10"
```
